## sdkconfig.defaults
```kconfig
# FreeRTOS clock to 1 kHz to allow 1ms delay
CONFIG_FREERTOS_HZ=1000

# ESP32 CPU frequency set to 240MHz
CONFIG_ESP32_DEFAULT_CPU_FREQ_240=y
CONFIG_ESP32_DEFAULT_CPU_FREQ_MHZ=240

CONFIG_ESPTOOLPY_FLASHSIZE_4MB=y
CONFIG_ESPTOOLPY_FLASHSIZE="4MB"

CONFIG_ESP32_DEFAULT_CPU_FREQ_240=y
CONFIG_ESP32_DEFAULT_CPU_FREQ_MHZ=240

# https://github.com/espressif/esp-idf/issues/5322
CONFIG_MBEDTLS_CERTIFICATE_BUNDLE_DEFAULT_CMN=y
```
